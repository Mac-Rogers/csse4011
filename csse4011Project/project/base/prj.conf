## CMakeLists.txt
```
cmake_minimum_required(VERSION 3.20.0)
find_package(Zephyr REQUIRED HINTS $ENV{ZEPHYR_BASE})

project(project/base)

set(CMAKE_C_COMPILE_FEATURES ${compile_features_c11})
list(APPEND CMAKE_MODULE_PATH ${ZEPHYR_BASE}/modules/nanopb)
include(nanopb)

# zephyr_nanopb_sources()

target_sources(app PRIVATE src/main.c src/bluetooth.c src/bluetoothtransmit.c)
```

## prj.conf
```kconfig
# shell logging
CONFIG_SHELL=y
CONFIG_SHELL_BACKEND_SERIAL=n
CONFIG_SHELL_PROMPT_BUFF_SIZE=30
CONFIG_SHELL_PROMPT_RTT="ENTER COMMAND :) "
CONFIG_LOG_CMDS=y
CONFIG_LOG=y
CONFIG_CBPRINTF_FP_SUPPORT=y

# bluetooth
CONFIG_BT=y
#CONFIG_BT_CENTRAL=y
#CONFIG_BT_GATT_CLIENT=y
#CONFIG_BT_MAX_CONN=1
CONFIG_BT_OBSERVER=y
CONFIG_BT_PERIPHERAL=y
```

## boards/nrf52840dk_nrf52840.overlay
```dts
/ {
    aliases {
    };
};
```

## src/main.c
```c
#include <zephyr/kernel.h>
#include <zephyr/bluetooth/bluetooth.h>
#include <zephyr/bluetooth/hci.h>
#include <zephyr/logging/log.h>
#include <zephyr/shell/shell.h>
#include <math.h>

LOG_MODULE_REGISTER(project_base);

bool init_bluetooth(void);

#define DEFINE_THREAD(entry) \
	void entry(void *, void *, void *); \
	K_THREAD_DEFINE(id_##entry, 2048, entry, NULL, NULL, NULL, 1, 0, 0)

DEFINE_THREAD(main_thread);

static int cmd_flash(const struct shell *, size_t, char **);
SHELL_CMD_REGISTER(flash, NULL, "flash the LED", cmd_flash);

static int cmd_flash(const struct shell *sh, size_t argc, char **argv) {
    shell_print(sh, "would flash the LED");
    return 0;
}

double init_pressures[4];
int num_init_pressures;

void handle_message(uint16_t major, uint16_t minor) {
    if (major == 2) {
        double angle = (double) minor / 100;
        angle = 180.0 - angle;
        printk("(tilt) %lf\n", angle);
    } else if (major == 3) {
        double pressure = (double) minor / 10000 + 100;
        if (num_init_pressures < 4) {
            init_pressures[num_init_pressures++] = pressure;
        }
        double sum = 0.0;
        for (int i = 0; i < num_init_pressures; ++i) {
            sum += init_pressures[i];
        }
        double init_pressure = sum / num_init_pressures;
        double height = (init_pressure - pressure) * 100 * 86;
        printk("(pressure) %lf\n", pressure);
        printk("(height) %lf\n", height);
    } else if (major == 4) {
        double dist = minor;
        printk("(distance) %lf\n", dist);
    }
}

void advertise(uint16_t major, uint16_t minor);
bool init_bluetooth_transmit(void);

void main_thread(void *, void *, void *) {
    if (!init_bluetooth() || !init_bluetooth_transmit()) {
        LOG_ERR("failed to init bluetooth");
        return;
    }

    uint32_t counter = 0;
    while (1) {
        advertise(0, counter++);
        k_msleep(50);
    }
}
```

## src/bluetooth.c
```c
#include <zephyr/kernel.h>
#include <zephyr/bluetooth/bluetooth.h>
#include <zephyr/bluetooth/hci.h>
#include <zephyr/logging/log.h>
#include <math.h>

LOG_MODULE_DECLARE(project_base);

void handle_message(uint16_t major, uint16_t minor);

static const uint8_t mobile_uuid[16] = {
    0xe2, 0xc5, 0x6d, 0xb5, 0xdf, 0xfb, 0x48, 0xd4,
    0xb0, 0x60, 0xd0, 0xf5, 0xa7, 0x10, 0x96, 0xe3
};

#define NUM_BEACONS 13
typedef struct { float x; float y; } BeaconPos;

static const BeaconPos beacon_pos[NUM_BEACONS] = {
    {0.0f, 0.0f},   /* A */
    {1.5f, 0.0f},   /* B */
    {3.0f, 0.0f},   /* C */
    {3.0f, 2.0f},   /* D */
    {3.0f, 4.0f},   /* E */
    {1.5f, 4.0f},   /* F */
    {0.0f, 4.0f},   /* G */
    {0.0f, 2.0f},   /* H */
    {4.5f, 0.0f},   /* I */
    {6.0f, 0.0f},   /* J */
    {6.0f, 2.0f},   /* K */
    {6.0f, 4.0f},   /* L */
    {4.5f, 4.0f},   /* M */
};

static float last_dist[NUM_BEACONS] = {
    [0 ... NUM_BEACONS-1] = -1.0f
};

static float x_hat = 3.0f, y_hat = 2.0f;
static float P_x = 25.0f, P_y = 25.0f;
static const float Q = 0.05f;
static const float R = 0.25f;

static inline float minor_to_distance(uint16_t minor)
{
    return powf(10.0f, (((float)minor) - 59.0f) / 20.0f);
}

static void kalman_update(float z_x, float z_y)
{
    P_x += Q;
    P_y += Q;

    float Kx = P_x / (P_x + R);
    float Ky = P_y / (P_y + R);

    x_hat += Kx * (z_x - x_hat);
    y_hat += Ky * (z_y - y_hat);

    P_x *= (1.0f - Kx);
    P_y *= (1.0f - Ky);

    printk("(coords) %.2lf %.2lf\n", (double) x_hat, (double) y_hat);
}

static bool handle_distance(uint16_t beacon_idx, uint16_t minor)
{
    if (beacon_idx != 1) {
        return false;
    }
    beacon_idx = (minor >> 8);
    minor = minor % 256;

    if (beacon_idx >= NUM_BEACONS)
        return false;

    last_dist[beacon_idx] = minor_to_distance(minor);

    int valid = 0;
    for (int i = 0; i < NUM_BEACONS; ++i)
        if (last_dist[i] > 0) ++valid;
    if (valid < 3)
        return false;

    float sum_w = 0.0f, est_x = 0.0f, est_y = 0.0f;
    for (int i = 0; i < NUM_BEACONS; ++i) {
        float d = last_dist[i];
        if (d <= 0) continue;
        float w = 1.0f / (d * d + 1e-3f);
        sum_w += w;
        est_x += w * beacon_pos[i].x;
        est_y += w * beacon_pos[i].y;
    }
    if (sum_w > 0.0f)
        kalman_update(est_x / sum_w, est_y / sum_w);
    return true;
}

static bool parse_mobile(const uint8_t *data, uint8_t len,
                         uint16_t *p_major, uint16_t *p_minor,
                         char *identifier)
{
    if (len < 25) return false;

    if (data[0] != 0x4C || data[1] != 0x00 || data[2] != 0x02 || data[3] != 0x15)
        return false;

    if (!memcmp(&data[4], mobile_uuid, 16)) {
        strcpy(identifier, "mobile");
    } else {
        return false;
    }

    *p_major = (data[20] << 8) | data[21];
    *p_minor = (data[22] << 8) | data[23];
    return true;
}

static void device_found(const bt_addr_le_t *addr, int8_t rssi,
                         uint8_t adv_type, struct net_buf_simple *ad)
{
    struct net_buf_simple ad_copy = *ad;
    while (ad_copy.len > 1) {
        uint8_t len = net_buf_simple_pull_u8(&ad_copy);
        if (!len || len > ad_copy.len) break;

        uint8_t ad_type = net_buf_simple_pull_u8(&ad_copy);
        const uint8_t *data = ad_copy.data;

        if (ad_type == BT_DATA_MANUFACTURER_DATA && len >= 2) {
            uint16_t major, minor; char id[16];
            if (parse_mobile(data, len - 1, &major, &minor, id)) {
                if (!strcmp(id, "mobile"))
                    if (!handle_distance(major, minor)) {
                        handle_message(major, minor);
                    }
            }
        }
        net_buf_simple_pull(&ad_copy, len - 1);
    }
}

bool init_bluetooth(void) {
    if (bt_enable(NULL)) {
        return false;
    }

    const struct bt_le_scan_param p = {
        .type     = BT_HCI_LE_SCAN_PASSIVE,
        .options  = BT_LE_SCAN_OPT_NONE,
        .interval = 0x0010,
        .window   = 0x0010,
    };
    bt_le_scan_start(&p, device_found);
    return true;
}
```

## src/bluetoothtransmit.c
```c
#include <stdio.h>
#include <zephyr/kernel.h>
#include <zephyr/drivers/pwm.h>
#include <zephyr/drivers/gpio.h>
#include <zephyr/logging/log.h>
#include <zephyr/drivers/sensor.h>
#include <zephyr/bluetooth/bluetooth.h>
#include <zephyr/bluetooth/hci.h>
#include <math.h>

LOG_MODULE_DECLARE(project_base);

static const uint8_t base_uuid[16] = {
    0xe2, 0xc5, 0x6d, 0xb5, 0xdf, 0xfb, 0x48, 0xd4,
    0xb0, 0x60, 0xd0, 0xf5, 0xa7, 0x10, 0x96, 0xe4
};

static struct bt_data ad[] = {
    BT_DATA_BYTES(BT_DATA_FLAGS, (BT_LE_AD_GENERAL | BT_LE_AD_NO_BREDR)),
    { .type = BT_DATA_MANUFACTURER_DATA,
      .data_len = 25, .data = NULL },
};

static struct bt_le_adv_param adv_param = {
    .id       = BT_ID_DEFAULT,
    .sid      = 0,
    .secondary_max_skip = 0,
    .options  = BT_LE_ADV_OPT_USE_IDENTITY,
    .interval_min = 0x0020,
    .interval_max = 0x0020,
    .peer = NULL,
};

void advertise(uint16_t major, uint16_t minor)
{
    static uint8_t beacon_data[25];

    beacon_data[0] = 0x4C; beacon_data[1] = 0x00;
    beacon_data[2] = 0x02; beacon_data[3] = 0x15;
    memcpy(&beacon_data[4], base_uuid, 16);

    beacon_data[20] = major >> 8;  beacon_data[21] = major;
    beacon_data[22] = minor >> 8;  beacon_data[23] = minor;
    beacon_data[24] = 0xC5;

    ad[1].data = beacon_data;
    static bool started;
    if (!started) {
        bt_le_adv_start(&adv_param, ad, ARRAY_SIZE(ad), NULL, 0);
        started = true;
    } else {
        bt_le_adv_update_data(ad, ARRAY_SIZE(ad), NULL, 0);
    }
}

void respond(const char *addr_str, int rssi) {
}

static void device_found(const bt_addr_le_t *addr, int8_t rssi,
    uint8_t adv_type, struct net_buf_simple *ad)
{
    char addr_str[BT_ADDR_LE_STR_LEN];
    bt_addr_le_to_str(addr, addr_str, sizeof(addr_str));

//    const char *beacon_id = identify_beacon(addr);
//    if (beacon_id) {
        respond(addr_str, rssi);
//    }
}

bool init_bluetooth_transmit(void) {
//    if (bt_enable(NULL) < 0) {
//        return false;
//    }
    struct bt_le_scan_param scan_params = {
        .type     = BT_HCI_LE_SCAN_PASSIVE,
        .options  = BT_LE_SCAN_OPT_NONE,
        .interval = 0x0010,
        .window   = 0x0010,
    };
    bt_le_scan_start(&scan_params, device_found);
    return true;
}
```
