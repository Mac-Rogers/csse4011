## CMakeLists.txt
```
cmake_minimum_required(VERSION 3.20.0)
find_package(Zephyr REQUIRED HINTS $ENV{ZEPHYR_BASE})
project(project/mobile)
target_sources(app PRIVATE src/main.c src/bluetooth.c src/bluetoothlisten.c src/us.c)
```

## prj.conf
```kconfig
# PWM
CONFIG_PWM=y

# pressure sensor
CONFIG_SENSOR=y
CONFIG_I2C=y

# shell logging
#CONFIG_USE_SEGGER_RTT=y
#CONFIG_UART_CONSOLE=n
#CONFIG_RTT_CONSOLE=y
#CONFIG_SHELL=y
#CONFIG_SHELL_BACKEND_SERIAL=n
#CONFIG_SHELL_BACKEND_RTT=y
#CONFIG_SHELL_PROMPT_BUFF_SIZE=30
#CONFIG_SHELL_PROMPT_RTT="ENTER COMMAND :) "
#CONFIG_LOG_CMDS=y
#CONFIG_LOG=y
#CONFIG_CBPRINTF_FP_SUPPORT=y

# bluetooth
CONFIG_BT=y
CONFIG_BT_OBSERVER=y
CONFIG_BT_PERIPHERAL=y
#CONFIG_BT_GATT_SERVICE_CHANGED=y

#for US
CONFIG_SERIAL=n
CONFIG_UART_CONSOLE=n
CONFIG_CONSOLE=n
CONFIG_STDOUT_CONSOLE=n
```

## boards/thingy52_nrf52832.overlay
```dts
/ {
    aliases {
        led = &led0;
        led2 = &led1;
        led3 = &led2;
        rtc = &rtc2;
        p-sensor = &lps22hb_press;
        pwm = &pwm0;
        acc = &lis2dh12;
        mygpio = &gpio0;
    };
};

&gpio0 {
    status = "okay";
};

&rtc2 {
    status = "okay";
};
```

## src/main.c
```c
#include <stdio.h>
#include <zephyr/kernel.h>
#include <zephyr/drivers/pwm.h>
#include <zephyr/drivers/gpio.h>
#include <zephyr/logging/log.h>
#include <zephyr/drivers/sensor.h>
#include <zephyr/bluetooth/bluetooth.h>
#include <zephyr/bluetooth/hci.h>
#include <math.h>

bool init_bluetooth(void);
void advertise(uint16_t major, uint16_t minor);

extern const struct device *gpio_dev;

LOG_MODULE_REGISTER(project_mobile);

#define DEFINE_THREAD(entry) \
	void entry(void *, void *, void *); \
	K_THREAD_DEFINE(id_##entry, 2048, entry, NULL, NULL, NULL, 1, 0, 0)

DEFINE_THREAD(main_thread);

static const struct gpio_dt_spec led = GPIO_DT_SPEC_GET(DT_ALIAS(led), gpios);
static const struct gpio_dt_spec led2 = GPIO_DT_SPEC_GET(DT_ALIAS(led2), gpios);
static const struct gpio_dt_spec led3 = GPIO_DT_SPEC_GET(DT_ALIAS(led3), gpios);
//static const struct device *pwm = DEVICE_DT_GET(DT_ALIAS(pwm));

//#define PWM_NODE DT_ALIAS(pwm)
//#define PWM_CHANNEL 0
//#define TONE_FREQ_HZ 200
//#define PERIOD_NS (1000000000UL / TONE_FREQ_HZ)
//#define DUTY_CYCLE (PERIOD_NS / 2)

static const struct device *const p_sensor = DEVICE_DT_GET(DT_ALIAS(p_sensor));
static const struct device *const acc = DEVICE_DT_GET(DT_ALIAS(acc));

#define M_PI 3.141592654

bool init_bluetooth_listen(void);

void handle_message(uint32_t major, uint32_t minor) {
    LOG_INF("message: %u %u", major, minor);
}

bool read_pressure(double *pressure) {
    if (sensor_sample_fetch(p_sensor) < 0) {
        return false;
    }

    struct sensor_value value;
    if (sensor_channel_get(p_sensor, SENSOR_CHAN_PRESS, &value) < 0) {
        return false;
    }
    *pressure = sensor_value_to_double(&value);
    return true;
}

bool read_acc(double *x, double *y, double *z) {
    if (sensor_sample_fetch(acc) < 0) {
        return false;
    }
   
    struct sensor_value value;
    if (sensor_channel_get(acc, SENSOR_CHAN_ACCEL_X, &value) < 0) {
        return false;
    }
    *x = sensor_value_to_double(&value);
    if (sensor_channel_get(acc, SENSOR_CHAN_ACCEL_Y, &value) < 0) {
        return false;
    }
    *y = sensor_value_to_double(&value);
    if (sensor_channel_get(acc, SENSOR_CHAN_ACCEL_Z, &value) < 0) {
        return false;
    }
    *z = sensor_value_to_double(&value);
    return true;
}

bool init_led(void) {
    if (!gpio_is_ready_dt(&led) || gpio_pin_configure_dt(&led, GPIO_OUTPUT_INACTIVE) < 0) {
        return false;
    }
    if (!gpio_is_ready_dt(&led2) || gpio_pin_configure_dt(&led2, GPIO_OUTPUT_INACTIVE) < 0) {
        return false;
    }
    if (!gpio_is_ready_dt(&led3) || gpio_pin_configure_dt(&led3, GPIO_OUTPUT_INACTIVE) < 0) {
        return false;
    }
    return true;
}

void led_set(int x, int state) {
    if (x == 0) {
        gpio_pin_set_dt(&led, state);
    } else if (x == 1) {
        gpio_pin_set_dt(&led2, state);
    } else if (x == 2) {
        gpio_pin_set_dt(&led3, state);
    }
}

#define PWM_CHANNEL 0
#define TONE_FREQ_HZ 100
#define PERIOD_NS (1000000000UL / TONE_FREQ_HZ)
#define DUTY_CYCLE (PERIOD_NS / 2)

/*
const struct device *init_pwm(void) {
    if (!device_is_ready(pwm)) {
        return NULL;
    }
    pwm_set(pwm, PWM_CHANNEL, PERIOD_NS, 0, 0);
    return pwm;
}
*/

bool init_pressure(void) {
    return device_is_ready(p_sensor);
}

bool init_acc(void) {
    return device_is_ready(acc);
}

/* PWM stuff

init_pwm();
pwm_set(pwm, PWM_CHANNEL, PERIOD_NS, DUTY_CYCLE, 0);
pwm_set(pwm, PWM_CHANNEL, PERIOD_NS, 0, 0);

*/

#define BUZZ_PIN 4

void main_thread(void *, void *, void *)
{
    if (!init_acc() || !init_pressure() || !init_led() || !init_bluetooth()) {
        return;
    }

    if (!init_bluetooth_listen()) {
        return;
    }
    
    
    //if (!init_pwm()) {
    //    return;
    //}

    led_set(0, 0);
    led_set(1, 1);
    led_set(2, 0);

	int state = 0;
	while (1) {
        double x, y, z;
        if (!read_acc(&x, &y, &z)) {
            LOG_ERR("failed to read accelerometer");
        }

        double pressure;
        if (!read_pressure(&pressure)) {
            LOG_ERR("failed to read pressure");
        }

        double angle = atan2(pow(x*x+y*y, 0.5), z) / M_PI * 180;
        advertise(2, (uint16_t) (angle * 100));

        k_msleep(20);

        advertise(3, (uint16_t) ((pressure - 100) * 10000));

        if (state % 10 == 0) {
            LOG_INF("did loop");
        }

		for (int i = 0; i < 3; ++i) {
// 			led_set(i, i == (state / 30) % 3);
		}
		k_msleep(20);
		state = (state + 1) % 90;
	}
}
```

## src/bluetooth.c
```c
#include <stdio.h>
#include <zephyr/kernel.h>
#include <zephyr/drivers/pwm.h>
#include <zephyr/drivers/gpio.h>
#include <zephyr/logging/log.h>
#include <zephyr/drivers/sensor.h>
#include <zephyr/bluetooth/bluetooth.h>
#include <zephyr/bluetooth/hci.h>
#include <math.h>

LOG_MODULE_DECLARE(project_mobile);

static const uint8_t mobile_uuid[16] = {
    0xe2, 0xc5, 0x6d, 0xb5, 0xdf, 0xfb, 0x48, 0xd4,
    0xb0, 0x60, 0xd0, 0xf5, 0xa7, 0x10, 0x96, 0xe3
};

static struct bt_data ad[] = {
    BT_DATA_BYTES(BT_DATA_FLAGS, (BT_LE_AD_GENERAL | BT_LE_AD_NO_BREDR)),
    { .type = BT_DATA_MANUFACTURER_DATA,
      .data_len = 25, .data = NULL },
};

static struct bt_le_adv_param adv_param = {
    .id       = BT_ID_DEFAULT,
    .sid      = 0,
    .secondary_max_skip = 0,
    .options  = BT_LE_ADV_OPT_USE_IDENTITY,
    .interval_min = 0x0020,
    .interval_max = 0x0020,
    .peer = NULL,
};

const char *identify_beacon(const bt_addr_le_t *addr_le)
{
    const char *beacon_strings[][2] = {
        { "A", "F5:75:FE:85:34:67" },
        { "B", "E5:73:87:06:1E:86" },
        { "C", "CA:99:9E:FD:98:B1" },
        { "D", "CB:1B:89:82:FF:FE" },
        { "E", "D4:D2:A0:A4:5C:AC" },
        { "F", "C1:13:27:E9:B7:7C" },
        { "G", "F1:04:48:06:39:A0" },
        { "H", "CA:0C:E0:DB:CE:60" },
        { "I", "CA:99:9E:FD:98:B1" },
        { "J", "F7:0B:21:F1:C8:E1" },
        { "K", "FD:E0:8D:FA:3E:4A" },
        { "L", "EE:32:F7:28:FA:AC" },
        { "M", "EA:E4:EC:C2:0C:18" },
    };
    size_t numBeacons = sizeof(beacon_strings)/sizeof(beacon_strings[0]);
    bt_addr_t beacons[numBeacons];
    for (size_t i = 0; i < numBeacons; ++i) {
        int err = bt_addr_from_str(beacon_strings[i][1], &beacons[i]);
        if (err) {
            LOG_ERR("Failed to parse MAC address\n");
        }
    }
    for (size_t i = 0; i < numBeacons; ++i) {
        if (!bt_addr_cmp(&addr_le->a, &beacons[i])) {
            return beacon_strings[i][0];
        }
    }
    return NULL;
}

void advertise(uint16_t major, uint16_t minor)
{
    static uint8_t beacon_data[25];

    beacon_data[0] = 0x4C; beacon_data[1] = 0x00;
    beacon_data[2] = 0x02; beacon_data[3] = 0x15;
    memcpy(&beacon_data[4], mobile_uuid, 16);

    beacon_data[20] = major >> 8;  beacon_data[21] = major;
    beacon_data[22] = minor >> 8;  beacon_data[23] = minor;
    beacon_data[24] = 0xC5;

    ad[1].data = beacon_data;
    static bool started;
    if (!started) {
        bt_le_adv_start(&adv_param, ad, ARRAY_SIZE(ad), NULL, 0);
        started = true;
    } else {
        bt_le_adv_update_data(ad, ARRAY_SIZE(ad), NULL, 0);
    }
}

void respond(const char *beacon_id, const char *addr_str, int rssi) {
    //LOG_INF("beacon data: %s; %s; %d", beacon_id, addr_str, rssi);
    uint8_t m1 = *beacon_id - 'A';
    uint8_t m2 = -rssi;
    advertise(1, (m1 << 8) | m2);
}

static void device_found(const bt_addr_le_t *addr, int8_t rssi,
    uint8_t adv_type, struct net_buf_simple *ad)
{
    char addr_str[BT_ADDR_LE_STR_LEN];
    bt_addr_le_to_str(addr, addr_str, sizeof(addr_str));

    const char *beacon_id = identify_beacon(addr);
    if (beacon_id) {
        respond(beacon_id, addr_str, rssi);
    }
}

bool init_bluetooth(void) {
    if (bt_enable(NULL) < 0) {
        return false;
    }
    struct bt_le_scan_param scan_params = {
        .type     = BT_HCI_LE_SCAN_PASSIVE,
        .options  = BT_LE_SCAN_OPT_NONE,
        .interval = 0x0010,
        .window   = 0x0010,
    };
    bt_le_scan_start(&scan_params, device_found);
    return true;
}
```

## src/bluetoothlisten.c
```c
#include <zephyr/kernel.h>
#include <zephyr/bluetooth/bluetooth.h>
#include <zephyr/bluetooth/hci.h>
#include <zephyr/logging/log.h>
#include <math.h>

void handle_message(uint32_t major, uint32_t minor);

static const uint8_t base_uuid[16] = {
    0xe2, 0xc5, 0x6d, 0xb5, 0xdf, 0xfb, 0x48, 0xd4,
    0xb0, 0x60, 0xd0, 0xf5, 0xa7, 0x10, 0x96, 0xe4
};

bool init_bluetooth_listen(void) {
    return true;
}
```

## src/us.c
```c
#include <zephyr/kernel.h>
#include <zephyr/drivers/gpio.h>
#include <zephyr/sys/printk.h>

void advertise(uint16_t major, uint16_t minor);

// Ultrasonic sensor connections
#define TRIGGER_PIN 2  // P0.02
#define ECHO_PIN    3  // P0.03

#define PULSE_TIMEOUT_US 30000  // 30 ms timeout (max ~5m range)

// Onboard LED (via SX1509B expander)
//static const struct gpio_dt_spec led = GPIO_DT_SPEC_GET(DT_ALIAS(led0), gpios);

const struct device *gpio_dev;

static volatile uint32_t echo_start_time;
static volatile uint32_t echo_end_time;
static volatile bool echo_received = false;

bool led_set(int, int);

#define DEFINE_THREAD(entry) \
	void entry(void *, void *, void *); \
	K_THREAD_DEFINE(id_##entry, 2048, entry, NULL, NULL, NULL, 1, 0, 0)

DEFINE_THREAD(us_thread);

static void echo_callback(const struct device *dev, struct gpio_callback *cb, uint32_t pins)
{
    if (gpio_pin_get(dev, ECHO_PIN)) {
        echo_start_time = k_cycle_get_32();
    } else {
        echo_end_time = k_cycle_get_32();
        echo_received = true;
    }
}

#define BUZZ_PIN 4

void us_thread(void *, void *, void *)
{
    const struct device *gpio_dev = DEVICE_DT_GET(DT_NODELABEL(gpio0));
    gpio_pin_configure(gpio_dev, 2, GPIO_OUTPUT_INACTIVE);

    struct gpio_callback echo_cb_data;
    uint32_t cycle_freq = sys_clock_hw_cycles_per_sec();

    // Configure echo pin as input with interrupt
    gpio_pin_configure(gpio_dev, ECHO_PIN, GPIO_INPUT);
    gpio_init_callback(&echo_cb_data, echo_callback, BIT(ECHO_PIN));
    gpio_add_callback(gpio_dev, &echo_cb_data);
    gpio_pin_interrupt_configure(gpio_dev, ECHO_PIN, GPIO_INT_EDGE_BOTH);

//    const struct device *gpio_dev = DEVICE_DT_GET(DT_NODELABEL(gpio0));
    gpio_pin_configure(gpio_dev, BUZZ_PIN, GPIO_OUTPUT_INACTIVE);
    gpio_pin_set(gpio_dev, BUZZ_PIN, 0);

    // Configure onboard LED as output
//    gpio_pin_configure_dt(&led, GPIO_OUTPUT_INACTIVE);

    while (1) {
        // Reset echo tracking
        echo_received = false;

        // Send 10µs trigger pulse
        gpio_pin_set(gpio_dev, TRIGGER_PIN, 1);
        k_busy_wait(10);
        gpio_pin_set(gpio_dev, TRIGGER_PIN, 0);

        // Wait for echo with timeout
        int64_t start_time = k_uptime_get();
        while (!echo_received && (k_uptime_get() - start_time < PULSE_TIMEOUT_US / 1000)) {
            k_msleep(1);
        }

        float distance_cm = -1.0f;

        if (echo_received) {
            uint32_t duration_cycles = echo_end_time - echo_start_time;
            uint32_t duration_us = (duration_cycles * 1000000U) / cycle_freq;
            distance_cm = (duration_us * 0.0343f) / 2.0f;
        }

        advertise(4, (uint16_t) (distance_cm));            

        if (distance_cm < 10 && distance_cm >= 1) {
            gpio_pin_set(gpio_dev, BUZZ_PIN, 1);
            led_set(0, 1);
            led_set(1, 0);
            led_set(2, 0);
        } else {
            gpio_pin_set(gpio_dev, BUZZ_PIN, 0);
            led_set(0, 0);
            led_set(1, 1);
            led_set(2, 0);
        }

        k_msleep(100);
    }
}
```
